#include "web_admin.h"

#include <WiFi.h>
#include <ESPAsyncWebServer.h>
#include <DNSServer.h>

#include "beacon_config.h"
#include "beacon_runtime.h"
#include "web_assets.h"  // generated by tools/compress.py

// config is read here only by webAdminLoop(), which runs in the main loop.
// HTTP handlers run in the AsyncTCP task and must use beacon_runtime.h
// (snapshot + queue) instead of touching config directly.
extern BeaconConfig config;

static AsyncWebServer server(80);
static DNSServer dnsServer;
static bool running = false;
static bool routesRegistered = false;
static String apSsid;
static String apIp = "10.0.0.8";

static volatile uint32_t lastActivityMs = 0;

static String stateName(int s) {
  switch (s) {
    case 0: return "StartupDelay";
    case 1: return "Idle";
    case 2: return "Transmitting";
    case 3: return "ContinuousTransmit";
    case 4: return "LowBatteryHalt";
    default: return "Unknown";
  }
}

static void markActivity() {
  lastActivityMs = millis();
}

// Quote a string for JSON output.
static String jsonString(const String &value) {
  String out = "\"";
  for (size_t i = 0; i < value.length(); ++i) {
    const char c = value.charAt(i);
    if (c == '"' || c == '\\') {
      out += '\\';
      out += c;
    } else if (static_cast<uint8_t>(c) < 0x20) {
      char buf[7];
      snprintf(buf, sizeof(buf), "\\u%04x", static_cast<uint8_t>(c));
      out += buf;
    } else {
      out += c;
    }
  }
  out += '"';
  return out;
}

static bool isOnValue(const String &value) {
  return value == "on" || value == "true" || value == "1";
}

// --- Async request handlers ---

static void handleRoot(AsyncWebServerRequest *request) {
  markActivity();
  AsyncWebServerResponse *response = request->beginResponse(
      200, "text/html", INDEX_HTML, INDEX_HTML_LEN);
  response->addHeader("Content-Encoding", "gzip");
  response->addHeader("Cache-Control", "no-store");
  request->send(response);
}

static void handleStyle(AsyncWebServerRequest *request) {
  markActivity();
  AsyncWebServerResponse *response = request->beginResponse(
      200, "text/css", STYLE_CSS, STYLE_CSS_LEN);
  response->addHeader("Content-Encoding", "gzip");
  response->addHeader("Cache-Control", "max-age=3600");
  request->send(response);
}

static void handleScript(AsyncWebServerRequest *request) {
  markActivity();
  AsyncWebServerResponse *response = request->beginResponse(
      200, "text/javascript", SCRIPT_JS, SCRIPT_JS_LEN);
  response->addHeader("Content-Encoding", "gzip");
  response->addHeader("Cache-Control", "max-age=3600");
  request->send(response);
}

static void handleGetConfig(AsyncWebServerRequest *request) {
  markActivity();
  const BeaconConfig c = beaconConfigSnapshot();
  String json = "{";
  json += "\"call\":" + jsonString(c.callSign) + ",";
  json += "\"fox\":" + jsonString(c.foxId) + ",";
  json += "\"beaconMode\":" + String(c.beaconMode ? "true" : "false") + ",";
  json += "\"foxSync\":" + String(c.foxSyncEnabled ? "true" : "false") + ",";
  json += "\"foxNum\":" + String(foxNumberFromId(c.foxId)) + ",";
  json += "\"startup\":" + String(c.startupDelaySeconds) + ",";
  json += "\"startupResolved\":" + String(resolvedStartupDelaySeconds(c)) + ",";
  json += "\"tx\":" + String(c.transmitSeconds) + ",";
  json += "\"idle\":" + String(c.idleSeconds) + ",";
  json += "\"beaconId\":" + String(c.beaconIdIntervalSeconds) + ",";
  json += "\"wpm\":" + String(c.cwWpm) + ",";
  json += "\"tone\":" + String(c.cwToneHz) + ",";
  json += "\"warble\":" + String(c.warbleEnabled ? "true" : "false") + ",";
  json += "\"warbleLow\":" + String(c.warbleLowHz) + ",";
  json += "\"warbleHigh\":" + String(c.warbleHighHz) + ",";
  json += "\"warbleStep\":" + String(c.warbleStepMs) + ",";
  json += "\"pttActiveLow\":" + String(c.pttActiveLow ? "true" : "false") + ",";
  json += "\"lead\":" + String(c.pttLeadMs) + ",";
  json += "\"tail\":" + String(c.pttTailMs) + ",";
  json += "\"batteryEnabled\":" + String(c.batteryEnabled ? "true" : "false") + ",";
  json += "\"batteryScale\":" + String(c.batteryScale, 3) + ",";
  json += "\"lowBattery\":" + String(c.lowBatteryVoltage, 2) + ",";
  json += "\"wifiAp\":" + String(c.wifiApEnabled ? "true" : "false") + ",";
  json += "\"wifiApTimeout\":" + String(c.wifiApTimeoutMinutes) + ",";
  json += "\"ecoMode\":" + String(c.displayEcoMode ? "true" : "false") + ",";
  json += "\"state\":\"" + stateName(beaconStateValue()) + "\",";
  if (c.batteryEnabled) {
    json += "\"battery\":\"" + String(beaconBatteryVoltage(), 2) + "\",";
    json += "\"batteryPct\":" + String(beaconBatteryPercent()) + ",";
  } else {
    json += "\"battery\":\"N/A\",";
  }
  json += "\"apSsid\":" + jsonString(apSsid) + ",";
  json += "\"ip\":" + jsonString(apIp) + ",";
  json += "\"version\":" + jsonString(FIRMWARE_VERSION);
  json += "}";
  request->send(200, "application/json", json);
}

// Update only the fields present in the form, starting from the current
// configuration, so a partial POST never zeroes other settings. Values are
// normalized and clamped exactly like the serial "set" commands.
static void handlePostConfig(AsyncWebServerRequest *request) {
  markActivity();
  if (!request->hasParam("call", true)) {
    request->send(400, "text/plain", "Missing form data");
    return;
  }

  BeaconConfig next = beaconConfigSnapshot();

  auto has = [&](const char *name) { return request->hasParam(name, true); };
  auto param = [&](const char *name) -> String {
    return request->getParam(name, true)->value();
  };

  if (has("call")) next.callSign = normalizeId(param("call"));
  if (has("fox")) next.foxId = normalizeId(param("fox"));
  if (has("mode")) {
    const String mode = param("mode");
    next.beaconMode = (mode == "beacon" || mode == "continuous");
  }
  if (has("fox_sync")) next.foxSyncEnabled = isOnValue(param("fox_sync"));

  if (has("startup")) next.startupDelaySeconds = constrain(param("startup").toInt(), 0L, 3600L);
  if (has("tx")) next.transmitSeconds = constrain(param("tx").toInt(), 3L, 600L);
  if (has("idle")) next.idleSeconds = constrain(param("idle").toInt(), 5L, 3600L);
  if (has("beacon_id")) next.beaconIdIntervalSeconds = constrain(param("beacon_id").toInt(), 10, 600);

  if (has("wpm")) next.cwWpm = constrain(param("wpm").toInt(), 5, 35);
  if (has("tone")) next.cwToneHz = constrain(param("tone").toInt(), 300, 1800);

  if (has("warble")) next.warbleEnabled = isOnValue(param("warble"));
  if (has("warble_low")) next.warbleLowHz = constrain(param("warble_low").toInt(), 300, 1800);
  if (has("warble_high")) next.warbleHighHz = constrain(param("warble_high").toInt(), 300, 1800);
  if (has("warble_step")) next.warbleStepMs = constrain(param("warble_step").toInt(), 100, 3000);

  if (has("ptt")) next.pttActiveLow = (param("ptt") == "active_low");
  if (has("lead")) next.pttLeadMs = constrain(param("lead").toInt(), 50, 3000);
  if (has("tail")) next.pttTailMs = constrain(param("tail").toInt(), 50, 3000);

  if (has("battery")) next.batteryEnabled = isOnValue(param("battery"));
  if (has("battery_scale")) next.batteryScale = constrain(param("battery_scale").toFloat(), 1.0f, 10.0f);
  if (has("low_battery")) next.lowBatteryVoltage = constrain(param("low_battery").toFloat(), 2.5f, 15.0f);

  if (has("wifi_ap")) next.wifiApEnabled = isOnValue(param("wifi_ap"));
  if (has("wifi_ap_timeout")) next.wifiApTimeoutMinutes = constrain(param("wifi_ap_timeout").toInt(), 0, 1440);

  if (has("eco_mode")) next.displayEcoMode = isOnValue(param("eco_mode"));

  beaconQueueConfig(next);
  request->send(200, "text/plain", "Saved. Settings apply now; timing changes take effect from the next cycle.");
}

static void handleTest(AsyncWebServerRequest *request) {
  markActivity();
  beaconQueueRequest(BeaconRequest::Test);
  request->send(200, "text/plain", "Test transmission queued.");
}

static void handlePttTest(AsyncWebServerRequest *request) {
  markActivity();
  beaconQueueRequest(BeaconRequest::PttTest);
  request->send(200, "text/plain", "PTT test queued (about 1.2 s).");
}

static void handleDefaults(AsyncWebServerRequest *request) {
  markActivity();
  beaconQueueRequest(BeaconRequest::Defaults);
  request->send(200, "text/plain", "Defaults restored and saved.");
}

static void handleReboot(AsyncWebServerRequest *request) {
  markActivity();
  request->send(200, "text/plain", "Rebooting...");
  beaconQueueRequest(BeaconRequest::Reboot);  // main loop restarts after the reply is sent
}

static void handleNotFound(AsyncWebServerRequest *request) {
  markActivity();
  // Captive portal: redirect all unknown URLs to root.
  request->redirect("http://" + apIp + "/");
}

static void registerRoutes() {
  if (routesRegistered) return;  // AsyncWebServer keeps handlers across end()/begin()
  server.on("/", HTTP_GET, handleRoot);
  server.on("/style.css", HTTP_GET, handleStyle);
  server.on("/script.js", HTTP_GET, handleScript);
  server.on("/api/config", HTTP_GET, handleGetConfig);
  server.on("/api/config", HTTP_POST, handlePostConfig);
  server.on("/api/test", HTTP_POST, handleTest);
  server.on("/api/ptt_test", HTTP_POST, handlePttTest);
  server.on("/api/defaults", HTTP_POST, handleDefaults);
  server.on("/api/reboot", HTTP_POST, handleReboot);
  server.onNotFound(handleNotFound);
  routesRegistered = true;
}

// --- Public API ---

void webAdminInit(const char *apNamePrefix) {
  if (running) return;

  uint64_t mac = ESP.getEfuseMac();
  char macSuffix[5];
  snprintf(macSuffix, sizeof(macSuffix), "%02X%02X",
           (uint8_t)(mac >> 8), (uint8_t)mac);
  apSsid = String(apNamePrefix) + "-" + macSuffix;

  WiFi.mode(WIFI_AP);
  WiFi.softAPConfig(IPAddress(10, 0, 0, 8), IPAddress(10, 0, 0, 8), IPAddress(255, 255, 255, 0));
  WiFi.softAP(apSsid.c_str());
  apIp = WiFi.softAPIP().toString();

  // Captive portal DNS: redirect all queries to our IP.
  dnsServer.start(53, "*", WiFi.softAPIP());

  registerRoutes();
  server.begin();

  running = true;
  lastActivityMs = millis();
  Serial.printf("BricoHams Fox Hunt Beacon — Web admin AP: %s, IP: %s\n", apSsid.c_str(), apIp.c_str());
}

void webAdminLoop() {
  if (!running) return;

  if (!config.wifiApEnabled) {
    webAdminStop();
    return;
  }

  // Process captive portal DNS requests.
  dnsServer.processNextRequest();

  // Track station connections as activity.
  if (WiFi.softAPgetStationNum() > 0) {
    markActivity();
  }

  // Auto-off AP after timeout with no activity. Not saved to flash, so the
  // AP comes back on the next boot.
  if (config.wifiApTimeoutMinutes > 0) {
    uint32_t timeoutMs = (uint32_t)config.wifiApTimeoutMinutes * 60UL * 1000UL;
    if (millis() - lastActivityMs >= timeoutMs) {
      Serial.printf("WiFi AP auto-off after %u minutes of inactivity.\n",
                    config.wifiApTimeoutMinutes);
      config.wifiApEnabled = false;
      webAdminStop();
    }
  }
}

void webAdminStop() {
  if (!running) return;
  server.end();
  dnsServer.stop();
  WiFi.softAPdisconnect(true);
  WiFi.mode(WIFI_OFF);
  running = false;
  Serial.println(F("Web admin AP stopped."));
}

String webAdminGetIp() {
  return apIp;
}

String webAdminGetSsid() {
  return apSsid;
}

bool webAdminIsRunning() {
  return running;
}
